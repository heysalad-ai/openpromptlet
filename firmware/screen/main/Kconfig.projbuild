## firmware/screen/main/Kconfig.projbuild
```kconfig
menu "OpenDotlet demo"
config OPENDOTLET_ENCODER_DEMO
    bool "Build encoder-screen demo instead of sticker gallery"
    default n
config OPENDOTLET_WIFI_UPDATE
    bool "Enable USB-provisioned authenticated Wi-Fi updates"
    default n
endmenu

config OPENPROMPTLET_ACTION_DEMO
    bool "Project summary controller demo"
    default n
```
